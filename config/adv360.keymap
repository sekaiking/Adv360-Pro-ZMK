#include <behaviors.dtsi>
#include <dt-bindings/zmk/keys.h>
#include <dt-bindings/zmk/bt.h>
#include <dt-bindings/zmk/rgb.h>
#include <dt-bindings/zmk/stp.h>
#include <dt-bindings/zmk/backlight.h>
#include <dt-bindings/zmk/pointing.h>

#define QWERTY  0
#define DVORAKP 1
#define GAMING  2
#define KEYPAD  3
#define FN      4
#define MOD     5

/ {
    behaviors {
      #include "macros.dtsi"
      #include "version.dtsi"
    };

  keymap {
    compatible = "zmk,keymap";
    #include "keymaps.dtsi"
  };
};
